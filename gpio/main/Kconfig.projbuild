## gpio/main/Kconfig.projbuild
```kconfig
menu "Actividad"
 config ACTIVIDAD_UNO
    string "Primera Actividad"
        default "Camina"	
        help
            descrivo primera actividad.

config ACTIVIDAD_DOS
    string "Primera Actividad"
        default "Come"
        help
            descrivo segunda actividad.

config ACTIVIDAD_TRES
    string "Primera Actividad"
        default "Se acuesta"
        help
            descrivo tercera actividad.

config ACTIVIDAD_CUATRO
    string "Primera Actividad"
        default "Se para"
        help
            descrivo cuarta actividad.

config ACTIVIDAD_CINCO
    string "Primera Actividad"
        default "Acostada"
        help
            descrivo quinta actividad.

config ACTIVIDAD_SEIS
    string "Primera Actividad"
        default "Mueve la cola"
        help
            descrivo sexta actividad.
			
config ACTIVIDAD_SIETE
    string "Primera Actividad"
        default "Mueve la cabeza"
        help
            descrivo séptima actividad.
			
config ACTIVIDAD_OCHO
    string "Primera Actividad"
        default "Parada"
        help
            descrivo séptima actividad.



endmenu



menu "SSD1306 Configuration"

    choice INTERFACE
        prompt "Interface"
        default I2C_INTERFACE
        help
            Select Interface.
        config I2C_INTERFACE
            bool "I2C Interface"
            help
                I2C Interface.
        config SPI_INTERFACE
            bool "SPI Interface"
            help
                SPI Interface.
    endchoice

if I2C_INTERFACE

    choice PANEL
        prompt "Panel Type"
        default SSD1306_128x64
        help
            Select Panel Type.
        config SSD1306_128x32
            bool "128x32 Panel"
            help
                Panel is 128x32.
        config SSD1306_128x64
            bool "128x64 Panel"
            help
                Panel is 128x64.
    endchoice

    config SCL_GPIO
        int "SCL GPIO number"
        range 0 34
        default 22
        help
            GPIO number (IOxx) to I2C SCL.
            Some GPIOs are used for other purposes (flash connections, etc.) and cannot be used to I2C.
            GPIOs 35-39 are input-only so cannot be used as outputs.

    config SDA_GPIO
        int "SDA GPIO number"
        range 0 34
        default 21
        help
            GPIO number (IOxx) to I2C SDA.
            Some GPIOs are used for other purposes (flash connections, etc.) and cannot be used to I2C.
            GPIOs 35-39 are input-only so cannot be used as outputs.

endif

    config RESET_GPIO
        int "RESET GPIO number"
        range -1 34
        default -1
        help
            GPIO number (IOxx) to RESET.
            When it is -1, RESET isn't performed.
            Some GPIOs are used for other purposes (flash connections, etc.) and cannot be used to Reset.
            GPIOs 35-39 are input-only so cannot be used as outputs.

if SPI_INTERFACE
    config CS_GPIO
        int "CS GPIO number"
        range 0 34
        default 15
        help
            GPIO number (IOxx) to SPI CS.
            Some GPIOs are used for other purposes (flash connections, etc.) and cannot be used to CS.
            GPIOs 35-39 are input-only so cannot be used as outputs.

    config DC_GPIO
        int "DC GPIO number"
        range 0 34
        default 33
        help
            GPIO number (IOxx) to SPI DC.
            Some GPIOs are used for other purposes (flash connections, etc.) and cannot be used to DC.
            GPIOs 35-39 are input-only so cannot be used as outputs.

endif

endmenu
```
